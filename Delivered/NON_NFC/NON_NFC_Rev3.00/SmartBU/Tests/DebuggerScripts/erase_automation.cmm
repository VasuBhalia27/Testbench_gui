; erase_automation.cmm
; Post-EOL de-flash: mass-erase all PSoC 4 (CY8C4149AZI-S575) internal flash via TRACE32.
; Called automatically by the automation orchestrator after EOL testing.
;
; Prerequisites:
;   - TRACE32 must already be connected to the target (SYStem.Up done by autoexec).
;   - psoc4.cmm must be present in the same directory as this script.
;
; This script does NOT reflash the device — erase only.
; The MCU is left blank and will not execute any firmware after this script.

; Halt target execution before any flash operation
Break

; Re-configure the PSoC 4 flash driver.
; PREPAREONLY: declare FLASH regions and load flash algorithm into SRAM,
; but do NOT program anything.  psoc4.cmm is in the same folder (~~~~).
DO ~~~~/psoc4 PREPAREONLY

; Mass-erase all flash sectors (entire program flash)
FLASH.Erase ALL

; Release flash programming resources (clean state before TRACE32 exits)
FLASH.ReProgram OFF

ENDDO
