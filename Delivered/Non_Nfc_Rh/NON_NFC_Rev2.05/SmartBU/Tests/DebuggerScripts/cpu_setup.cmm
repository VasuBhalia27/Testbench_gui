;* ************************************************************************ */
;* ************************************************************************ */
;*                                                                          */
;* !Stack           : n/a                                                   */
;* !Component       : n/a                                                   */
;* !Module          : Setup CPU                                             */
;*                                                                          */
;* !Description     :                                                       */
;*                                                                          */
;* Lauterbach Trace32 script to perform an intial CPU setup of a            */
;* CY8C4146LQA target.                                                      */
;*                                                                          */
;* !File            : cpu_setup.cmm                                         */
;* !Scope           : n/a                                                   */
;* !Target          : CY8C4146LQA-S433 (type on the AUDI Logo pcb)          */
;* !Vendor          : U-Shin                                                */
;* !Coding language : T32 Script                                            */
;*                                                                          */
;*                         (C) Copyright 2017 by                            */
;*                 U-Shin Deutschland Zugangssysteme GmbH                   */
;*                           All right reserved                             */
;*            This software is the exclusive property of U-Shin.            */
;*    It cannot be communicated or divulged to anybody without a previous   */
;*   written authorization                                                  */
;*                                                                          */
;*      Any partial or complete copy of this program whether it is in its   */
;*    original shape or in its modified shape has to mention this copyright */
;*   and its proprietor                                                     */
;*                                                                          */
;* ************************************************************************ */
;* ************************************************************************ */


;* ************************************************************************ */
;* Script Code                                                              */
;* ************************************************************************ */
; initialize and start the debugger
RESet
SYStem.RESet
; SYStem.CPU CY8C4149AZI-S575
SYStem.CPU CY8C4149AZI-S575
SYStem.CONFIG.DEBUGPORTTYPE SWD
IF COMBIPROBE()||UTRACE()
(
  SYStem.CONFIG.CONNECTOR MIPI20T
)
SYStem.Option ResBreak OFF
SYStem.Option DUALPORT ON
SYSTEM.CPUACCESS ENABLE
SYStem.MemAccess DAP
SYStem.JtagClock CTCK 10MHz
Trace.DISable
SYStem.Up


;* ************************************************************************ */

ENDDO

;* ************************************************************************ */
;* ************************************************************************ */
;* End of Script                                                            */
;* ************************************************************************ */
;* ************************************************************************ */
