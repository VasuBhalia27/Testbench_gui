;* ************************************************************************ */
;* Configuration                                                            */
;* ************************************************************************ */

; CPU Type
&cpuType=cpu()


;* ************************************************************************ */
;* Variable Declarations                                                    */
;* ************************************************************************ */


;* ************************************************************************ */
;* Script Code                                                              */
;* ************************************************************************ */

; run Trace32 startup script
DO ~~\autostart.cmm

IF OS.FILE(~~~~\windows_setup_user.cmm)
   ; ... user's own file
   DO ~~~~\windows_setup_user.cmm
ELSE
   ; ... project's default file
   DO ~~~~\windows_setup.cmm

; run project setup script
DO ~~~~\cpu_setup.cmm
; flash 
DO ~~~~\flash.cmm



;* ************************************************************************ */

ENDDO

;* ************************************************************************ */
;* ************************************************************************ */
;* End of Script                                                            */
;* ************************************************************************ */
;* ************************************************************************ */
